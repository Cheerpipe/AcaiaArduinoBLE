## idf/components/EspressoScaleBLE/Kconfig
```kconfig
choice ESPRESSO_SCALE_BLE_BACKEND
    prompt "Espresso scale BLE backend"
    default ESPRESSO_SCALE_BLE_BACKEND_ARDUINOBLE
    help
        Select exactly one BLE host for the scale client. ArduinoBLE remains
        the rollback default until the phase-5 physical soak and beta gate are
        approved. NimBLE is the release candidate.

    config ESPRESSO_SCALE_BLE_BACKEND_ARDUINOBLE
        bool "ArduinoBLE (temporary rollback)"

    config ESPRESSO_SCALE_BLE_BACKEND_NIMBLE
        bool "ESP-IDF NimBLE (release candidate)"
        depends on BT_NIMBLE_ENABLED

endchoice
```

## idf/main/Kconfig.projbuild
```kconfig
menu "Advanced Shot Stopper"

    config SHOT_STOPPER_ENABLE_REMOTE_MACHINE_CONTROL
        bool "Enable remote machine control"
        default n
        help
            Security opt-in. When disabled (the default) or compiled with
            SHOT_STOPPER_ENABLE_REMOTE_MACHINE_CONTROL=0, firmware rejects
            remote start and rinse over HTTP/API; only the physical activator
            can close the machine circuit. Stop remains available.
            Enable with this Kconfig or
            -DSHOT_STOPPER_ENABLE_REMOTE_MACHINE_CONTROL=1. The legacy
            -DSHOT_STOPPER_ENABLE_REMOTE_CN9 alias still maps onto this flag.
            Command-line -DSHOT_STOPPER_ENABLE_REMOTE_MACHINE_CONTROL=… still
            overrides.

    config SHOT_STOPPER_MACHINE_TYPE
        int "Machine type (0=paddle/latch, 1=momentary switch, 2=momentary+reed)"
        range 0 2
        default 0
        help
            Compile-time machine switch. 0 is paddle or latch (persistent
            GPIO). 1 is a momentary switch. 2 is a momentary switch plus a
            reed that reports whether the group is actually running.
            Command-line -DSHOT_STOPPER_MACHINE_TYPE=… still overrides.

    config SHOT_STOPPER_ENABLE_BUZZER
        int "Buzzer mode (0=off, 1=passive RTTTL)"
        range 0 1
        default 1
        help
            Maps to the SHOT_STOPPER_ENABLE_BUZZER compile-time macro.
            0=off, 1=passive piezo (PWM/RTTTL melodies).
            Command-line -DSHOT_STOPPER_ENABLE_BUZZER=… still overrides.

    config SHOT_STOPPER_DEVELOPMENT
        bool "Development build (bypass WebUI admin unlock)"
        default n
        help
            When enabled, compiles with SHOT_STOPPER_DEVELOPMENT=1 so the
            WebUI treats every client as admin-unlocked: Admin and Diagnostic
            controls and Home Actions need no device-password session.
            For local/dev builds only — never ship to production devices.
            Command-line -DSHOT_STOPPER_DEVELOPMENT=… still overrides.

    config SHOT_STOPPER_ENABLE_JTAG
        int "USB Serial/JTAG (0=off, 1=on at boot)"
        range 0 1
        default 0
        help
            Maps to the SHOT_STOPPER_ENABLE_JTAG compile-time macro.
            0 (default) keeps the IDF USB Serial/JTAG console off so the
            PHY stays down until the GPIO4 jumper calls Serial.begin.
            1 turns USB Serial/JTAG on at boot for OpenOCD and CDC without
            the jumper. Flash firmware built with
            -DSHOT_STOPPER_ENABLE_JTAG=1; omitting the flag leaves JTAG off.
            Command-line -DSHOT_STOPPER_ENABLE_JTAG=… still overrides.

endmenu
```
